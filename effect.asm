			LIST		P=16F84A 		 ;Kullanýlan PIC türü
			#INCLUDE	<P16F84A.INC>	 ;PIC16F84A kutuphanesi dahil edýyoruz
			ORG			H'00'			 ;0. Satýrdan Program Baþlatýlýyor
SAYAC1		EQU			H'0C'			 ; SAYAC1 DEGISKENINE H'0C' YUKLE
SAYAC2		EQU			H'0D'			 ; SAYAC2 DEGISKENINE H'D' YUKLE
KNT			EQU			H'0E'			 ; KNT DEGISKENINE H'0E' YUKLE
			
			BSF			STATUS,5		;BANK1'E GEÇ
			CLRF		TRISB			;TRIB'YÝ TEMÝZLE(PORTB ÇIKIÞ)
			MOVLW		H'FF'			;W'YE h'FF' YÜKLE
			MOVWF		TRISA			;W'YÝ TRISA'YA YÜKLE(PORTA GÝRÝÞ)
			BCF			STATUS,5		;BANK0'A GEÇ
			CLRF		PORTB			;PORTB'YÝ TEMÝZLE
SAG1
			BTFSC		PORTA,0			;PORTA'NIN 0. BÝTÝ '0' MI?
			GOTO		SOL1			;HAYIR. SOL1 ETÝKETÝNE GÝT
			MOVLW		H'03'			;EVET.	W'YE h'03' YÜKLE
			MOVWF		KNT				;W'YÝ KNT'YE YÜKLE
SAG
			MOVLW		H'0F'			;W'YE h'0F' YÜKLE
			MOVWF		PORTB			;W'YÝ PORTB'DEN ÇIK
			CALL		GECIKME			;ZAMAN ALT PROGRAMINI ÇAÐIR
			CLRF		PORTB			;PORTB'YÝ TEMÝZLE
			CALL		GECIKME			;ZAMAN ALT PROGRAMINI ÇAÐIR
			DECFSZ		KNT,F			;KNT'DEN '1' ÇIKAR KNT'YE YÜKLE. KNT '0' MÝ?
			GOTO		SAG				;HAYIR. BIR ETÝKETÝNE GÝT
			GOTO		SAG1			;EVET. SAG1 ETÝKETÝNE GÝT
SOL1
			BTFSC		PORTA,1			;PORTA'NIN 1. BÝTÝ 'O' MI?
			GOTO		TUM1			;HAYIR. TUM ETÝKETÝNE GÝT
			MOVLW		H'03'			;EVET. W'YE h'03' YÜKLE
			MOVWF		KNT				;W'YÝ KNT'YE YÜKLE
SOL
			MOVLW		H'F0'			;W'YE h'F0' YÜKLE
			MOVWF		PORTB			;W'YÝ PORTB'DEN ÇIK
			CALL		GECIKME			;ZAMAN ALT PROGRAMINI ÇAÐIR
			CLRF		PORTB			;PORTB'YÝ TEMÝZLE
			CALL		GECIKME			;ZAMAN ALT PROGRAMINI ÇAÐIR
			DECFSZ		KNT,F			;KNT'DEN '1' ÇIKAR KNT'YE YÜKLE. KNT '0' MÝ?
			GOTO		SOL				;HAYIR. IKI ETÝKETÝNE GÝT
			GOTO		SAG1			;EVET. SAG1 ETÝKETÝNE GÝT
TUM1
			BTFSC		PORTA,2			;PORTA'NIN 2. BÝTÝ 'O' MI?
			GOTO		SAG_SOL1	 	;HAYIR. SAG_SOL1 ETÝKETÝNE GÝT
			MOVLW		H'03'			;EVET. W'YE h'03' YÜKLE
			MOVWF		KNT				;W'YÝ KNT'YE YÜKLE
TUM
			MOVLW		H'FF'			;W'YE h'FF' YÜKLE
			MOVWF		PORTB			;W'YÝ PORTB'DEN ÇIK
			CALL		GECIKME			;ZAMAN ALT PROGRAMINI ÇAÐIR
			CLRF		PORTB			;PORTB'YÝ TEMÝZLE
			CALL		GECIKME			;ZAMAN ALT PROGRAMINI ÇAÐIR
			DECFSZ		KNT,F			;KNT'DEN '1' ÇIKAR KNT'YE YÜKLE. KNT '0' MÝ?
			GOTO		TUM				;HAYIR. TUM ETÝKETÝNE GÝT
			GOTO		SAG1			;EVET. SAG1 ETÝKETÝNE GÝT
SAG_SOL1
			BTFSC		PORTA,3			;PORTA'NIN 3. BÝTÝ 'O' MI?
			GOTO		SAG1			;HAYIR. SAG1 ETÝKETÝNE GÝT
			MOVLW		H'03'			;EVET. W'YE h'03' YÜKLE
			MOVWF		KNT				;W'YÝ KNT'YE YÜKLE
SAG_SOL
			MOVLW		H'0F'			;W'YE h'0F' YÜKLE
			MOVWF		PORTB			;W'YÝ PORTB'DEN ÇIK
			CALL		GECIKME			;ZAMAN ALT PROGRAMINI ÇAÐIR
			MOVLW		H'F0'			;W'YE h'F0' YÜKLE
			MOVWF		PORTB			;W'YÝ PORTB'DEN ÇIK
			CALL		GECIKME			;ZAMAN ALT PROGRAMINI ÇAÐIR
			DECFSZ		KNT,F			;KNT'DEN '1' ÇIKAR KNT'YE YÜKLE. KNT '0' MÝ?
			GOTO		SAG_SOL			;HAYIR. SAG_SOL ETÝKETÝNE GÝT
			CLRF		PORTB			;EVET. PORTB'YÝ TEMÝZLE
			GOTO		SAG1			;SAG1 ETÝKETÝNE GÝT
GECIKME		
			MOVLW		H'FF'			;W'YE h'FF' YÜKLE
			MOVWF		SAYAC1			;W'YÝ SAYAC1'E YÜKLE 
DONGU1
			MOVLW		H'FF'			;W'YE h'FF' YÜKLE
			MOVWF		SAYAC2			;W'YÝ SAYAC2'E YÜKLE 
DONGU2		
			DECFSZ		SAYAC2,F		;SAYAC2'DEN '1' ÇIKAR SAYAC2'YE YÜKLE. SAY2 '0' MÝ?		
			GOTO		DONGU2			;HAYIR. DONGU2 ETÝKETÝNE GÝT
			DECFSZ		SAYAC1,F		;EVET. SAYAC1'DEN '1' ÇIKAR SAY1'YE YÜKLE. SAY1 '0' MÝ?	
			GOTO		DONGU1			;HAYIR. DONGU1 ETÝKETÝNE GÝT
			RETURN						;EVET. ALT PROGRAMIN SONU 	
			END							;PROGRAMIN SONU 

		
